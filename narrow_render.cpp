// SPDX-License-Identifier: PolyForm-Noncommercial-1.0.0
// Copyright (c) 2026 TheRepairForge
// PocketOBI narrow text path (docs/NARROW_GLYPHS.md): UTF-8 decoding for every build, accented Latin and
// Vietnamese drawn as the current font's ASCII base letter + mark bitmaps (glyphs_narrow.h, generated by
// tools/gen_narrow_glyphs.py), the few full glyphs (sharp s), and the UTF-8-aware measuring helpers.
// The wide (CJK) glyphs stay in cjk_render.cpp, compiled only with ENABLE_CJK=1.
#include "ui_host.h"   // the firmware header of this tree (ui_host.h, D46 M3)
#include "glyphs_narrow.h"

#if ENABLE_CJK
#define WIDE_ADV_GFX CJK_ADV_GFX
#endif

static const NarrowComp* findComp(uint32_t cp) {
  int lo = 0, hi = NARROW_COMP_N - 1;
  while (lo <= hi) {
    int mid = (lo + hi) >> 1;
    uint16_t c = pgm_read_word(&NARROW_COMP[mid].cp);
    if (c == cp) return &NARROW_COMP[mid];
    if (c < cp) lo = mid + 1; else hi = mid - 1;
  }
  return nullptr;
}

static const GFXglyph* gfxGlyph(const GFXfont* f, uint8_t c) {
  uint8_t first = pgm_read_byte(&f->first), last = pgm_read_byte(&f->last);
  if (c < first || c > last) return nullptr;
  return &(((GFXglyph*)f->glyph)[c - first]);
}

// A GFX font is recognised by content, never by address: every translation unit that includes a font
// header holds its own copy of it (const = internal linkage). Same formula as the generator.
static uint32_t fontPrint(const GFXfont* f) {
  const GFXglyph* g = gfxGlyph(f, 'W');
  return ((uint32_t)pgm_read_byte(&f->yAdvance) << 16) | (g ? pgm_read_word(&g->bitmapOffset) : 0);
}

static const NarrowFull* findFull(const GFXfont* f, uint8_t k) {
  uint32_t fp = fontPrint(f);
  for (int i = 0; i < NARROW_FULL_N; i++)
    if (NARROW_FULL[i].fp == fp && NARROW_FULL[i].full == k) return &NARROW_FULL[i];
  return nullptr;
}

// The ASCII letter whose advance and bounds a narrow letter takes ('B' for the sharp s, 'i' for dotless i).
static char standIn(const NarrowComp* e) {
  uint8_t b = e->base;
  if (b == 1) return 'i';
  if (b == 2) return 'j';
  if (b >= 16 && b < 32) return NARROW_FULL_STANDIN[b - 16];
  return (char)b;
}

// Advance of cp in font f (nullptr = classic) at text size sx/sy: what drawing it moves the cursor by.
static int advanceIn(const GFXfont* f, int sx, int sy, uint32_t cp) {
  if (!f) {
#if ENABLE_CJK
    if (cp >= 0x80 && !findComp(cp)) return cjkAdv(sy);
#endif
    (void)sy;
    return 6 * sx;
  }
  if (cp < 0x80) { const GFXglyph* g = gfxGlyph(f, cp); return g ? pgm_read_byte(&g->xAdvance) * sx : 0; }
  if (const NarrowComp* e = findComp(cp)) {
    if (e->base >= 16 && e->base < 32) {
      if (const NarrowFull* fg = findFull(f, e->base - 16)) return fg->adv * sx;
      int w = 0;
      for (const char* p = NARROW_FULL_FALLBACK[e->base - 16]; *p; p++) w += advanceIn(f, sx, sy, (uint8_t)*p);
      return w;
    }
    return advanceIn(f, sx, sy, (uint8_t)standIn(e));
  }
#if ENABLE_CJK
  return WIDE_ADV_GFX;
#else
  return advanceIn(f, sx, sy, 'x');
#endif
}

int PocketTFT::advanceOf(uint32_t cp) { return advanceIn(gfxFont, textsize_x, textsize_y, cp); }

// ---- UTF-8 decoding ----
size_t PocketTFT::write(uint8_t c) {
  if (need_) {                                    // continuation byte of a multi-byte char
    if ((c & 0xC0) != 0x80) { need_ = 0; return write(c); }   // malformed: resync on c
    cp_ = (cp_ << 6) | (c & 0x3F);
    if (--need_ == 0) drawCp(cp_);
    return 1;
  }
  if (c < 0x80) return Adafruit_ST7789::write(c);
  if      ((c & 0xE0) == 0xC0) { cp_ = c & 0x1F; need_ = 1; }
  else if ((c & 0xF0) == 0xE0) { cp_ = c & 0x0F; need_ = 2; }
  else if ((c & 0xF8) == 0xF0) { cp_ = c & 0x07; need_ = 3; }
  return 1;                                       // stray continuation byte: ignored
}

size_t PocketTFT::write(const uint8_t *buf, size_t n) {
  need_ = 0; cp_ = 0;
  for (size_t i = 0; i < n; i++) write(buf[i]);
  need_ = 0; cp_ = 0;
  return n;
}

void PocketTFT::drawCp(uint32_t cp) {
  if (drawNarrow(cp)) return;
#if ENABLE_CJK
  drawWide(cp);
#else
  drawMissing();
#endif
}

// A code point no table holds: a hollow box one 'x' wide (a forgotten regeneration is visible).
void PocketTFT::drawMissing() {
  int adv = advanceOf('x');
  int h = gfxFont ? adv : 7 * textsize_y;
  int top = gfxFont ? cursor_y - h : cursor_y;
  drawRect(cursor_x, top, adv - 1, h, textcolor);
  cursor_x += adv;
}

// ---- drawing a composed letter ----
struct InkBox { int x0, y0, x1, y1; };            // x1/y1 exclusive

// One mark of a set at (x, y) = its top-left, each art pixel an sx x sy block.
static void drawArt(Adafruit_GFX& d, const NarrowArt* set, const uint8_t* bits, uint8_t id, int x, int y,
                    int sx, int sy, uint16_t col) {
  const NarrowArt& a = set[id];
  const int rb = (a.w + 7) / 8;
  for (int r = 0; r < a.h; r++)
    for (int c = 0; c < a.w; c++)
      if (pgm_read_byte(&bits[a.off + r * rb + (c >> 3)]) & (0x80 >> (c & 7))) {
        if (sx == 1 && sy == 1) d.drawPixel(x + c, y + r, col);
        else                    d.fillRect(x + c * sx, y + r * sy, sx, sy, col);
      }
}

// Place the marks of e around the base's ink box b. gap = the space between ink and mark. `flatCap`: the
// marks above a capital keep the horizontal scale but drop to 1 px rows with a 1 px gap, so a large
// capital (18/24 pt status words) keeps its accent inside the card it sits in.
static void drawMarks(Adafruit_GFX& d, const NarrowComp* e, InkBox b, bool classic, int sc, bool flatCap,
                      uint16_t col) {
  const NarrowArt* set = classic ? NARROW_ART_S : NARROW_ART_M;
  const uint8_t* bits = classic ? NARROW_ART_S_BITS : NARROW_ART_M_BITS;
  const int syA = flatCap ? 1 : sc, gapA = flatCap ? 1 : sc;
  const int cx = (b.x0 + b.x1) / 2;
  int above = b.y0 - gapA;                        // the next ABOVE mark ends just above this row
  int below = b.y1 + sc;
  int circRight = 0, circTop = 0;                 // set once a circumflex is drawn (Vietnamese ấ ầ ẩ)
  for (int k = 0; k < 4; k++) {
    uint8_t id = e->mark[k];
    if (!id) continue;
    const NarrowArt& a = set[id];
    const int w = a.w * sc, h = a.h * sc;
    switch (a.place) {
      case P_ABOVE:
        // Vietnamese sets acute, grave and hook to the upper right of a circumflex, not above it: one row
        // higher than its top, starting at its right end. Saves a mark's height (a tilde still stacks).
        if (circRight && (id == NM_ACUTE || id == NM_GRAVE || id == NM_HOOK)) {
          drawArt(d, set, bits, id, circRight - sc, circTop - (a.h - 1) * syA - syA, sc, syA, col);
          break;
        }
        drawArt(d, set, bits, id, cx - w / 2, above - a.h * syA, sc, syA, col);
        if (id == NM_CIRCUMFLEX) { circRight = cx - w / 2 + w; circTop = above - a.h * syA; }
        above -= a.h * syA + gapA;
        break;
      case P_BELOW:    drawArt(d, set, bits, id, cx - w / 2, below, sc, sc, col); below += h; break;
      case P_OGONEK:   drawArt(d, set, bits, id, b.x1 - w + sc, b.y1 - sc, sc, sc, col); break;
      case P_HORN:     drawArt(d, set, bits, id, b.x1 - sc, b.y0 - h + 2 * sc, sc, sc, col); break;
      case P_STROKE:   drawArt(d, set, bits, id, cx - w / 2, (b.y0 + b.y1) / 2 - h / 2, sc, sc, col); break;
      case P_STROKE_L: drawArt(d, set, bits, id, b.x0 - sc, (b.y0 + b.y1) / 2 - h / 2, sc, sc, col); break;
      case P_BAR_HI:   drawArt(d, set, bits, id, b.x1 - w + sc, b.y0 + sc, sc, sc, col); break;
      case P_BAR_MID:  drawArt(d, set, bits, id, b.x0 - (classic ? 1 : 2) * sc, (b.y0 + b.y1) / 2 - h / 2, sc, sc, col); break;
    }
  }
}

// Blit GFX glyph rows [from, h) at baseline (x, y); returns the ink box drawn. `skipDot` drops every row
// down to the first blank one: i and j without their dot.
static InkBox blitGfx(Adafruit_GFX& d, const GFXfont* f, const GFXglyph* g, const uint8_t* bmp, int x, int y,
                      bool skipDot, uint16_t col) {
  const uint8_t w = pgm_read_byte(&g->width), h = pgm_read_byte(&g->height);
  const int xo = (int8_t)pgm_read_byte(&g->xOffset), yo = (int8_t)pgm_read_byte(&g->yOffset);
  uint16_t bo = pgm_read_word(&g->bitmapOffset);
  int from = 0;
  if (skipDot) {                                  // rows are packed bit by bit: find the first blank row
    for (int r = 0; r < h; r++) {
      bool any = false;
      for (int c = 0; c < w; c++) {
        int bit = r * w + c;
        if (pgm_read_byte(&bmp[bo + (bit >> 3)]) & (0x80 >> (bit & 7))) { any = true; break; }
      }
      if (!any) { from = r + 1; break; }
    }
  }
  for (int r = from; r < h; r++)
    for (int c = 0; c < w; c++) {
      int bit = r * w + c;
      if (pgm_read_byte(&bmp[bo + (bit >> 3)]) & (0x80 >> (bit & 7))) d.drawPixel(x + xo + c, y + yo + r, col);
    }
  return { x + xo, y + yo + from, x + xo + w, y + yo + h };
}

// 5 classic columns (bit 0 = top row) at (x, y), scaled; opaque when the text has a background.
static void blitClassic(Adafruit_GFX& d, const uint8_t* cols, int x, int y, int sx, int sy, uint16_t fg, uint16_t bg) {
  if (bg != fg) d.fillRect(x, y, 6 * sx, 8 * sy, bg);
  for (int c = 0; c < 5; c++) {
    uint8_t v = pgm_read_byte(&cols[c]);
    for (int r = 0; r < 8; r++)
      if (v >> r & 1) {
        if (sx == 1 && sy == 1) d.drawPixel(x + c, y + r, fg);
        else                    d.fillRect(x + c * sx, y + r * sy, sx, sy, fg);
      }
  }
}

bool PocketTFT::drawNarrow(uint32_t cp) {
  const NarrowComp* e = findComp(cp);
  if (!e) return false;
  const uint8_t base = e->base;
  const bool full = base >= 16 && base < 32, dotless = base == 1 || base == 2;
  const int adv = advanceOf(cp);
  if (!gfxFont) {                                 // classic font: a 6 x 8 cell per letter
    const int sx = textsize_x, sy = textsize_y;
    if (wrap && cursor_x + 6 * sx > _width) { cursor_x = 0; cursor_y += 8 * sy; }
    if (full)         blitClassic(*this, NARROW_CLASSIC[2 + base - 16], cursor_x, cursor_y, sx, sy, textcolor, textbgcolor);
    else if (dotless) blitClassic(*this, NARROW_CLASSIC[base - 1], cursor_x, cursor_y, sx, sy, textcolor, textbgcolor);
    else              drawChar(cursor_x, cursor_y, base, textcolor, textbgcolor, sx, sy);
    const uint16_t cb = e->cbox;
    InkBox b = { cursor_x + ((cb >> 3) & 7) * sx, cursor_y + (cb & 7) * sy,
                 cursor_x + (((cb >> 6) & 7) + 1) * sx, cursor_y + (((cb >> 9) & 7) + 1) * sy };
    drawMarks(*this, e, b, true, sx, false, textcolor);
    cursor_x += adv;
    return true;
  }
  const GFXfont* f = gfxFont;
  const uint8_t* bmp = (const uint8_t*)f->bitmap;
  if (full) {
    const NarrowFull* fg = findFull(f, base - 16);
    if (!fg) {                                    // this font has no full glyph: its fallback text
      for (const char* p = NARROW_FULL_FALLBACK[base - 16]; *p; p++) Adafruit_ST7789::write((uint8_t)*p);
      return true;
    }
    if (wrap && cursor_x + adv > _width) { cursor_x = 0; cursor_y += pgm_read_byte(&f->yAdvance); }
    GFXglyph g = { fg->off, fg->w, fg->h, fg->adv, fg->xo, fg->yo };
    blitGfx(*this, f, &g, NARROW_FULL_BITS, cursor_x, cursor_y, false, textcolor);
    cursor_x += adv;
    return true;
  }
  const GFXglyph* g = gfxGlyph(f, (uint8_t)standIn(e));
  if (!g) return false;
  if (wrap && cursor_x + adv > _width) { cursor_x = 0; cursor_y += pgm_read_byte(&f->yAdvance); }
  InkBox b = blitGfx(*this, f, g, bmp, cursor_x, cursor_y, dotless, textcolor);
  // Mark scale from the x-height: 1 up to 12 pt, 2 at 18 and 24 pt.
  const GFXglyph* gx = gfxGlyph(f, 'x');
  const int xh = gx ? pgm_read_byte(&gx->height) : 10;
  const int sc = xh < 18 ? 1 : 2;
  drawMarks(*this, e, b, false, sc, sc > 1 && base >= 'A' && base <= 'Z', textcolor);
  cursor_x += adv;
  return true;
}

// ---- measuring ----
// Each code point of s: fn(cp). Malformed sequences are skipped byte by byte.
template <typename F> static void eachCp(const char* s, F fn) {
  for (const uint8_t* p = (const uint8_t*)s; *p; ) {
    uint8_t c = *p++;
    if (c < 0x80) { fn((uint32_t)c); continue; }
    int need = (c & 0xE0) == 0xC0 ? 1 : (c & 0xF0) == 0xE0 ? 2 : (c & 0xF8) == 0xF0 ? 3 : 0;
    if (!need) continue;                          // stray continuation byte: no character
    uint32_t cp = c & (0x3F >> need);
    while (need && (*p & 0xC0) == 0x80) { cp = (cp << 6) | (*p++ & 0x3F); need--; }
    if (!need) fn(cp);
  }
}

void PocketTFT::getTextBounds(const char *s, int16_t x, int16_t y, int16_t *x1, int16_t *y1, uint16_t *w, uint16_t *h) {
  // Each narrow letter becomes its ASCII stand-in, which has the same advance: Adafruit then measures the
  // ink as usual. A wide or missing character becomes 'x' letters of about its width (only the extent matters here).
  char proxy[128]; size_t n = 0;
  eachCp(s, [&](uint32_t cp) {
    if (n >= sizeof(proxy) - 4) return;
    if (cp < 0x80) { proxy[n++] = (char)cp; return; }
    const NarrowComp* e = findComp(cp);
    if (e && !(e->base >= 16 && e->base < 32 && gfxFont && !findFull(gfxFont, e->base - 16))) { proxy[n++] = standIn(e); return; }
    if (e) { for (const char* p = NARROW_FULL_FALLBACK[e->base - 16]; *p && n < sizeof(proxy) - 4; p++) proxy[n++] = *p; return; }
    int a = advanceOf(cp), sp = advanceOf('x');
    for (int k = 0; sp > 0 && k * sp < a && n < sizeof(proxy) - 4; k++) proxy[n++] = 'x';
  });
  proxy[n] = 0;
  Adafruit_ST7789::getTextBounds(proxy, x, y, x1, y1, w, h);
}

int cjkCharLen(const char* s) {
  uint8_t c = (uint8_t)*s;
  if (c < 0x80) return 1;
  int n = 1;
  while (n < 4 && ((uint8_t)s[n] & 0xC0) == 0x80) n++;   // at most 4 bytes: a malformed run cannot overflow a char[5]
  return n;
}

bool cjkHasWide(const char* s) {
  for (; *s; s++) if ((uint8_t)*s >= 0x80) return true;
  return false;
}

int cjkWidth(const GFXfont* f, const char* s) {
  int w = 0;
  eachCp(s, [&](uint32_t cp) { w += advanceIn(f, 1, 1, cp); });
  return w;
}

int txtW(const char* s, int size) {
  int w = 0;
  eachCp(s, [&](uint32_t cp) {
#if ENABLE_CJK
    if (cp >= 0x80 && !findComp(cp)) { w += cjkAdv(size); return; }
#endif
    w += 6 * size;
  });
  return w;
}

void narrowUpper(char* p, int cl) {
  if (cl < 2 || cl > 3) return;                   // p is not NUL-terminated here: decode cl bytes only
  const uint8_t* q = (const uint8_t*)p;
  uint32_t cp = cl == 2 ? ((uint32_t)(q[0] & 0x1F) << 6) | (q[1] & 0x3F)
                        : ((uint32_t)(q[0] & 0x0F) << 12) | ((uint32_t)(q[1] & 0x3F) << 6) | (q[2] & 0x3F);
  const NarrowComp* e = findComp(cp);
  if (!e || !e->upper) return;
  char buf[3]; int n;
  uint32_t u = e->upper;
  if (u < 0x800) { buf[0] = 0xC0 | (u >> 6); buf[1] = 0x80 | (u & 0x3F); n = 2; }
  else           { buf[0] = 0xE0 | (u >> 12); buf[1] = 0x80 | ((u >> 6) & 0x3F); buf[2] = 0x80 | (u & 0x3F); n = 3; }
  if (n == cl) memcpy(p, buf, n);
}
